## CMakeLists.txt
```
# SPDX-License-Identifier: Apache-2.0

cmake_minimum_required(VERSION 3.28.0)
find_package(Zephyr REQUIRED HINTS $ENV{ZEPHYR_BASE})
project(lis2dh_fifo_dbg)

target_sources(app PRIVATE src/main.c)
target_sources_ifdef(CONFIG_MCUMGR_TRANSPORT_BT app PRIVATE src/bluetooth.c)
```

## sysbuild.conf
```
# Copyright The Zephyr Project Contributors
# SPDX-License-Identifier: Apache-2.0

# Build MCUboot as a separate image and produce a single merged hex.
SB_CONFIG_BOOTLOADER_MCUBOOT=y
SB_CONFIG_BOOT_SIGNATURE_TYPE_ED25519=y
SB_CONFIG_MERGED_HEX_FILES=y
```

## prj.conf
```kconfig
# Copyright The Zephyr Project Contributors
# SPDX-License-Identifier: Apache-2.0
#
# Test-only firmware: LIS2DH FIFO streaming + MCUboot + MCUmgr over BLE.
# Not intended for upstream.

# --- LIS2DH FIFO streaming (Sensor Async API + RTIO) ---
CONFIG_SENSOR=y
CONFIG_SENSOR_ASYNC_API=y
CONFIG_LIS2DH=y
CONFIG_LIS2DH_TRIGGER_GLOBAL_THREAD=y
CONFIG_LIS2DH_STREAM=y
# The HOLYIOT-25008 SoC has no nRF TEMP peripheral.
CONFIG_TEMP_NRF5=n

# --- Console and local shell on UART20 ---
CONFIG_CONSOLE=y
CONFIG_PRINTK=y
CONFIG_SHELL=y
CONFIG_SHELL_BACKEND_SERIAL=y
# The shell management group captures command output through the dummy backend.
CONFIG_SHELL_BACKEND_DUMMY=y
CONFIG_SHELL_BACKEND_DUMMY_BUF_SIZE=2048
CONFIG_LOG=y
CONFIG_LOG_DEFAULT_LEVEL=3
CONFIG_CBPRINTF_FP_SUPPORT=y

# --- Whole console over BLE through the MCUmgr SHELL group ---
CONFIG_KERNEL_SHELL=y
CONFIG_DEVICE_SHELL=y
CONFIG_DEVMEM_SHELL=y
CONFIG_SENSOR_SHELL=y
CONFIG_STATS_SHELL=y
CONFIG_FLASH_SHELL=y

# --- Bluetooth peripheral ---
CONFIG_BT=y
CONFIG_BT_PERIPHERAL=y
CONFIG_BT_SMP=y
CONFIG_BT_SETTINGS=y
CONFIG_BT_MAX_CONN=1
CONFIG_BT_MAX_PAIRED=2
CONFIG_BT_DEVICE_NAME="LIS2DH FIFO debug"
CONFIG_BT_DIS=y
CONFIG_BT_DIS_PNP=n
CONFIG_BT_BAS=y

# --- MCUmgr over BLE (nRF Connect Device Manager) ---
CONFIG_MCUMGR=y
CONFIG_MCUMGR_GRP_OS=y
CONFIG_MCUMGR_GRP_IMG=y
CONFIG_MCUMGR_GRP_STAT=y
CONFIG_MCUMGR_GRP_SHELL=y
CONFIG_MCUMGR_TRANSPORT_BT=y
CONFIG_MCUMGR_TRANSPORT_BT_PERM_RW_ENCRYPT=y
CONFIG_MCUMGR_TRANSPORT_BT_CONN_PARAM_CONTROL=y
CONFIG_MCUMGR_TRANSPORT_BT_REASSEMBLY=y
# Large enough for a full captured shell response (dummy buffer + CBOR overhead).
CONFIG_MCUMGR_TRANSPORT_NETBUF_SIZE=2475
CONFIG_MCUMGR_TRANSPORT_WORKQUEUE_STACK_SIZE=4096

# --- MCUboot DFU ---
CONFIG_BOOTLOADER_MCUBOOT=y
CONFIG_IMG_MANAGER=y
CONFIG_STREAM_FLASH=y
CONFIG_FLASH=y
CONFIG_FLASH_MAP=y
CONFIG_REBOOT=y
CONFIG_CRC=y
CONFIG_ZCBOR=y

# --- Persistent Bluetooth bonds ---
CONFIG_SETTINGS=y
CONFIG_NVS=y
CONFIG_SETTINGS_NVS=y

# --- Diagnostics exposed through the OS group ---
CONFIG_THREAD_MONITOR=y
CONFIG_MCUMGR_GRP_OS_TASKSTAT=y
CONFIG_STATS=y
CONFIG_STATS_NAMES=y

# --- Stacks ---
CONFIG_MAIN_STACK_SIZE=4096
CONFIG_SYSTEM_WORKQUEUE_STACK_SIZE=4096
CONFIG_HEAP_MEM_POOL_SIZE=16384
```

## boards/holyiot_25008_nrf54l15_cpuapp.overlay
```dts
/*
 * Copyright The Zephyr Project Contributors
 *
 * SPDX-License-Identifier: Apache-2.0
 */

/* Bluetooth on nRF54L15 needs both the high- and low-frequency clocks. */
&xo {
	status = "okay";
};

&lfclk {
	status = "okay";
};

/* LIS2DH12 on SPI00, INT1 on GPIO2.0 (see the board DTS). */
&lis2dh {
	fifo-watermark = <16>;
};
```

## src/main.c
```c
/*
 * Copyright The Zephyr Project Contributors
 *
 * SPDX-License-Identifier: Apache-2.0
 */

#include <inttypes.h>
#include <stdio.h>

#include <zephyr/device.h>
#include <zephyr/drivers/sensor.h>
#include <zephyr/kernel.h>
#include <zephyr/rtio/rtio.h>
#include <zephyr/stats/stats.h>

#define LOG_LEVEL CONFIG_LOG_DEFAULT_LEVEL
#include <zephyr/logging/log.h>
LOG_MODULE_REGISTER(lis2dh_fifo_dbg, CONFIG_LOG_DEFAULT_LEVEL);

#include "bluetooth.h"

#define ACCEL_STREAM_TRIGGERS                                                                      \
	{SENSOR_TRIG_FIFO_WATERMARK, SENSOR_STREAM_DATA_INCLUDE},                                  \
	{                                                                                          \
		SENSOR_TRIG_FIFO_FULL, SENSOR_STREAM_DATA_INCLUDE                                  \
	}

SENSOR_DT_STREAM_IODEV(accel_stream, DT_ALIAS(accel0), ACCEL_STREAM_TRIGGERS);
RTIO_DEFINE_WITH_MEMPOOL(stream_ctx, 1, 1, 20, 256, sizeof(void *));

static const struct device *const accel = DEVICE_DT_GET(DT_ALIAS(accel0));

/* Exposed to the MCUmgr `stat` group, e.g. `mcumgr ... stat list`. */
STATS_SECT_START(lis2dh_fifo_stats)
STATS_SECT_ENTRY(batches)
STATS_SECT_ENTRY(frames)
STATS_SECT_END;

STATS_NAME_START(lis2dh_fifo_stats)
STATS_NAME(lis2dh_fifo_stats, batches)
STATS_NAME(lis2dh_fifo_stats, frames)
STATS_NAME_END(lis2dh_fifo_stats);

STATS_SECT_DECL(lis2dh_fifo_stats) lis2dh_fifo_stats;

static void report_fifo_batch(const uint8_t *buffer)
{
	const struct sensor_decoder_api *decoder;
	struct sensor_three_axis_data accel_data;
	struct sensor_chan_spec channel = {SENSOR_CHAN_ACCEL_XYZ, 0};
	uint16_t frame_count;
	uint32_t fit = 0U;
	int status;

	status = sensor_get_decoder(accel, &decoder);
	if (status < 0) {
		LOG_ERR("Cannot get LIS2DH decoder: %d", status);
		return;
	}

	status = decoder->get_frame_count(buffer, channel, &frame_count);
	if (status < 0) {
		LOG_ERR("Cannot get FIFO frame count: %d", status);
		return;
	}

	STATS_INC(lis2dh_fifo_stats, batches);
	STATS_INCN(lis2dh_fifo_stats, frames, frame_count);

	while (fit < frame_count) {
		status = decoder->decode(buffer, channel, &fit, 1U, &accel_data);
		if (status < 0) {
			LOG_ERR("Cannot decode FIFO frame: %d", status);
			return;
		}

		LOG_DBG("%" PRIu64 " ns: (%" PRIq(6) ", %" PRIq(6) ", %" PRIq(6) ") m/s^2",
			PRIsensor_three_axis_data_arg(accel_data, 0));
	}
}

static void stream_thread(void *p1, void *p2, void *p3)
{
	struct rtio_sqe *handle;
	struct rtio_cqe *cqe;
	uint8_t *buffer = NULL;
	uint32_t buffer_len = 0U;
	int status;

	ARG_UNUSED(p1);
	ARG_UNUSED(p2);
	ARG_UNUSED(p3);

	if (!device_is_ready(accel)) {
		LOG_ERR("LIS2DH device is not ready");
		return;
	}

	status = sensor_stream(&accel_stream, &stream_ctx, NULL, &handle);
	if (status < 0) {
		LOG_ERR("Cannot start LIS2DH FIFO stream: %d", status);
		return;
	}

	LOG_INF("LIS2DH FIFO stream started");

	while (true) {
		cqe = rtio_cqe_consume_block(&stream_ctx);
		status = cqe->result;
		if (status == 0) {
			status = rtio_cqe_get_mempool_buffer(&stream_ctx, cqe, &buffer,
							     &buffer_len);
		}
		rtio_cqe_release(&stream_ctx, cqe);
		if (status < 0) {
			LOG_ERR("FIFO stream failed: %d", status);
			return;
		}

		report_fifo_batch(buffer);
		rtio_release_buffer(&stream_ctx, buffer, buffer_len);
	}
}

K_THREAD_DEFINE(stream_tid, 4096, stream_thread, NULL, NULL, NULL, 7, 0, 0);

int main(void)
{
	int rc;

	rc = STATS_INIT_AND_REG(lis2dh_fifo_stats, STATS_SIZE_32, "lis2dh_fifo_stats");
	if (rc < 0) {
		LOG_ERR("Cannot register LIS2DH FIFO stats: %d", rc);
	}

	/* Start advertising so a remote client can reach the SMP service. */
	start_smp_bluetooth_adverts();

	LOG_INF("LIS2DH FIFO debug firmware ready");

	return 0;
}
```

## src/bluetooth.c
```c
/*
 * Copyright (c) 2012-2014 Wind River Systems, Inc.
 * Copyright (c) 2020 Prevas A/S
 *
 * SPDX-License-Identifier: Apache-2.0
 */

#include <zephyr/bluetooth/bluetooth.h>
#include <zephyr/bluetooth/conn.h>
#include <zephyr/bluetooth/gatt.h>
#include <zephyr/bluetooth/hci.h>
#include <zephyr/mgmt/mcumgr/transport/smp_bt.h>

#include <zephyr/logging/log.h>
LOG_MODULE_REGISTER(lis2dh_fifo_dbg_bt, CONFIG_LOG_DEFAULT_LEVEL);

#include "bluetooth.h"

static struct k_work advertise_work;

static const struct bt_data ad[] = {
	BT_DATA_BYTES(BT_DATA_FLAGS, (BT_LE_AD_GENERAL | BT_LE_AD_NO_BREDR)),
	BT_DATA_BYTES(BT_DATA_UUID128_ALL, SMP_BT_SVC_UUID_VAL),
};

static const struct bt_data sd[] = {
	BT_DATA(BT_DATA_NAME_COMPLETE, CONFIG_BT_DEVICE_NAME, sizeof(CONFIG_BT_DEVICE_NAME) - 1),
};

static void advertise(struct k_work *work)
{
	int rc;

	ARG_UNUSED(work);

	rc = bt_le_adv_start(BT_LE_ADV_CONN_FAST_1, ad, ARRAY_SIZE(ad), sd, ARRAY_SIZE(sd));
	if (rc != 0) {
		LOG_ERR("Advertising failed to start (rc %d)", rc);
		return;
	}

	LOG_INF("Advertising as \"%s\"", CONFIG_BT_DEVICE_NAME);
}

static void connected(struct bt_conn *conn, uint8_t err)
{
	if (err != 0U) {
		LOG_ERR("Connection failed, err 0x%02x %s", err, bt_hci_err_to_str(err));
		k_work_submit(&advertise_work);
	} else {
		LOG_INF("Connected");
	}
}

static void disconnected(struct bt_conn *conn, uint8_t reason)
{
	LOG_INF("Disconnected, reason 0x%02x %s", reason, bt_hci_err_to_str(reason));
}

static void on_conn_recycled(void)
{
	k_work_submit(&advertise_work);
}

BT_CONN_CB_DEFINE(conn_callbacks) = {
	.connected = connected,
	.disconnected = disconnected,
	.recycled = on_conn_recycled,
};

static void bt_ready(int err)
{
	if (err != 0) {
		LOG_ERR("Bluetooth failed to initialise: %d", err);
		return;
	}

	k_work_submit(&advertise_work);
}

void start_smp_bluetooth_adverts(void)
{
	int rc;

	k_work_init(&advertise_work, advertise);
	rc = bt_enable(bt_ready);

	if (rc != 0) {
		LOG_ERR("Bluetooth enable failed: %d", rc);
	}
}
```

## src/bluetooth.h
```c
/*
 * Copyright (c) 2020 Prevas A/S
 *
 * SPDX-License-Identifier: Apache-2.0
 */

#ifndef LIS2DH_FIFO_DBG_BLUETOOTH_H_
#define LIS2DH_FIFO_DBG_BLUETOOTH_H_

void start_smp_bluetooth_adverts(void);

#endif /* LIS2DH_FIFO_DBG_BLUETOOTH_H_ */
```
