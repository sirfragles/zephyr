## CMakeLists.txt
```
# SPDX-License-Identifier: Apache-2.0

cmake_minimum_required(VERSION 3.20.0)
find_package(Zephyr REQUIRED HINTS $ENV{ZEPHYR_BASE})
project(wheel_speed_sensor)

target_sources(app PRIVATE src/main.c src/wheel_csc.c src/wheel_detector.c)
```

## sysbuild.conf
```
# Copyright (c) 2026 Mateusz Zerebecki
# SPDX-License-Identifier: Apache-2.0

SB_CONFIG_BOOTLOADER_MCUBOOT=y
SB_CONFIG_BOOT_SIGNATURE_TYPE_ED25519=y
SB_CONFIG_MERGED_HEX_FILES=y
```

## prj.conf
```kconfig
# Copyright (c) 2026 Mateusz Zerebecki
# SPDX-License-Identifier: Apache-2.0

# Sensor and LIS2DH12 FIFO streaming
CONFIG_SENSOR=y
CONFIG_SENSOR_ASYNC_API=y
CONFIG_SENSOR_CLOCK_SYSTEM=y
CONFIG_LIS2DH=y
CONFIG_LIS2DH_TRIGGER_GLOBAL_THREAD=y
CONFIG_LIS2DH_STREAM=y

# Bluetooth Cycling Speed and Cadence, battery, and device information
CONFIG_BT=y
CONFIG_BT_PERIPHERAL=y
CONFIG_BT_SMP=y
CONFIG_BT_SETTINGS=y
CONFIG_BT_MAX_CONN=1
CONFIG_BT_MAX_PAIRED=2
CONFIG_BT_DEVICE_NAME="Open Wheel Speed"
CONFIG_BT_DEVICE_APPEARANCE=1157
CONFIG_BT_DIS=y
CONFIG_BT_DIS_PNP=n
CONFIG_BT_BAS=y

# BLE SMP transport for nRF Connect Device Manager
CONFIG_MCUMGR=y
CONFIG_MCUMGR_GRP_IMG=y
CONFIG_MCUMGR_GRP_OS=y
CONFIG_MCUMGR_TRANSPORT_BT=y
CONFIG_MCUMGR_TRANSPORT_BT_PERM_RW_ENCRYPT=y
CONFIG_MCUMGR_TRANSPORT_BT_CONN_PARAM_CONTROL=y
CONFIG_MCUMGR_TRANSPORT_BT_REASSEMBLY=y
CONFIG_MCUMGR_TRANSPORT_NETBUF_SIZE=1024
CONFIG_MCUMGR_TRANSPORT_WORKQUEUE_STACK_SIZE=3072

# MCUboot image management and persistent Bluetooth bonds
CONFIG_BOOTLOADER_MCUBOOT=y
CONFIG_IMG_MANAGER=y
CONFIG_STREAM_FLASH=y
CONFIG_FLASH=y
CONFIG_FLASH_MAP=y
CONFIG_SETTINGS=y
CONFIG_NVS=y
CONFIG_SETTINGS_NVS=y
CONFIG_REBOOT=y
CONFIG_CRC=y
CONFIG_ZCBOR=y

# Prototype diagnostics. Disable the console in the battery-life build.
CONFIG_LOG=y
CONFIG_LOG_DEFAULT_LEVEL=3
CONFIG_MAIN_STACK_SIZE=4096
CONFIG_SYSTEM_WORKQUEUE_STACK_SIZE=3072
CONFIG_CBPRINTF_FP_SUPPORT=n
```

## src/main.c
```c
/*
 * Copyright (c) 2026 Mateusz Zerebecki
 *
 * SPDX-License-Identifier: Apache-2.0
 */

#include <errno.h>
#include <math.h>
#include <stdint.h>

#include <zephyr/device.h>
#include <zephyr/dfu/mcuboot.h>
#include <zephyr/drivers/sensor.h>
#include <zephyr/kernel.h>
#include <zephyr/logging/log.h>
#include <zephyr/rtio/rtio.h>
#include <zephyr/sys/reboot.h>

#include "wheel_csc.h"
#include "wheel_detector.h"

LOG_MODULE_REGISTER(wheel_speed, LOG_LEVEL_INF);

#define WHEEL_SENSOR_NODE DT_ALIAS(accel0)

#define WHEEL_STREAM_TRIGGERS                                                                      \
	{SENSOR_TRIG_FIFO_FULL, SENSOR_STREAM_DATA_INCLUDE},                                       \
	{                                                                                          \
		SENSOR_TRIG_FIFO_WATERMARK, SENSOR_STREAM_DATA_INCLUDE                             \
	}

SENSOR_DT_STREAM_IODEV(wheel_sensor_iodev, WHEEL_SENSOR_NODE, WHEEL_STREAM_TRIGGERS);
RTIO_DEFINE_WITH_MEMPOOL(wheel_rtio, 2, 2, 8, 256, sizeof(void *));

static const struct device *const accelerometer = DEVICE_DT_GET(WHEEL_SENSOR_NODE);
static struct wheel_detector detector;
static bool image_confirmed;

static void reboot_unhealthy_image(void)
{
	/* Leave a test image unconfirmed so MCUboot rolls back after the reboot. */
	k_sleep(K_SECONDS(1));
	sys_reboot(SYS_REBOOT_COLD);
}

static float q31_to_float(q31_t value, int8_t shift)
{
	return ldexpf((float)value, shift - 31);
}

static int configure_accelerometer(void)
{
	struct sensor_value value;
	int err;

	value.val1 = 100;
	value.val2 = 0;
	err = sensor_attr_set(accelerometer, SENSOR_CHAN_ACCEL_XYZ, SENSOR_ATTR_SAMPLING_FREQUENCY,
			      &value);
	if (err != 0) {
		return err;
	}

	sensor_g_to_ms2(16, &value);
	return sensor_attr_set(accelerometer, SENSOR_CHAN_ACCEL_XYZ, SENSOR_ATTR_FULL_SCALE,
			       &value);
}

static void confirm_healthy_image(void)
{
	int err;

	if (image_confirmed) {
		return;
	}

	if (!boot_is_img_confirmed()) {
		err = boot_write_img_confirmed();
		if (err != 0) {
			LOG_ERR("Could not confirm MCUboot image: %d", err);
			return;
		}
		LOG_INF("MCUboot test image confirmed");
	}

	image_confirmed = true;
}

static int process_fifo_buffer(const uint8_t *buffer)
{
	const struct sensor_decoder_api *decoder;
	struct sensor_three_axis_data decoded = {0};
	struct wheel_revolution_event event;
	struct sensor_chan_spec channel = {SENSOR_CHAN_ACCEL_XYZ, 0};
	uint32_t fit = 0U;
	uint16_t frame_count;
	int err;

	err = sensor_get_decoder(accelerometer, &decoder);
	if (err != 0) {
		return err;
	}

	err = decoder->get_frame_count(buffer, channel, &frame_count);
	if (err != 0) {
		return err;
	}

	for (uint16_t i = 0U; i < frame_count; i++) {
		uint64_t timestamp_ns;
		float x_ms2;
		float y_ms2;

		err = decoder->decode(buffer, channel, &fit, 1U, &decoded);
		if (err != 1) {
			return err < 0 ? err : -EIO;
		}

		timestamp_ns =
			decoded.header.base_timestamp_ns + decoded.readings[0].timestamp_delta;
		x_ms2 = q31_to_float(decoded.readings[0].x, decoded.shift);
		y_ms2 = q31_to_float(decoded.readings[0].y, decoded.shift);

		/*
		 * The PCB is expected to be mounted parallel to the wheel, making X/Y the
		 * rotating plane. Axis selection will be calibrated on real hardware.
		 */
		if (wheel_detector_process(&detector, x_ms2, y_ms2, timestamp_ns, &event)) {
			LOG_INF("Wheel revolution %u", event.cumulative_revolutions);
			wheel_csc_publish(event.cumulative_revolutions, event.last_event_time_1024);
		}
	}

	return 0;
}

static int run_sensor_stream(void)
{
	struct rtio_sqe *stream_handle;
	int err;

	err = sensor_stream(&wheel_sensor_iodev, &wheel_rtio, NULL, &stream_handle);
	if (err != 0) {
		return err;
	}

	while (true) {
		struct rtio_cqe *cqe;
		uint8_t *buffer;
		uint32_t buffer_len;

		cqe = rtio_cqe_consume_block(&wheel_rtio);
		if (cqe->result != 0) {
			err = cqe->result;
			rtio_cqe_release(&wheel_rtio, cqe);
			return err;
		}

		err = rtio_cqe_get_mempool_buffer(&wheel_rtio, cqe, &buffer, &buffer_len);
		rtio_cqe_release(&wheel_rtio, cqe);
		if (err != 0) {
			return err;
		}

		err = process_fifo_buffer(buffer);
		rtio_release_buffer(&wheel_rtio, buffer, buffer_len);
		if (err != 0) {
			return err;
		}

		/* Sensor, FIFO, decoder, and RTIO all worked before accepting an update. */
		confirm_healthy_image();
	}
}

int main(void)
{
	int err;

	if (!device_is_ready(accelerometer)) {
		LOG_ERR("LIS2DH12 is not ready");
		reboot_unhealthy_image();
	}

	err = configure_accelerometer();
	if (err != 0) {
		LOG_ERR("LIS2DH12 configuration failed: %d", err);
		reboot_unhealthy_image();
	}

	wheel_detector_init(&detector);
	err = wheel_csc_start();
	if (err != 0) {
		LOG_ERR("Bluetooth initialization failed: %d", err);
		reboot_unhealthy_image();
	}

	LOG_INF("Wheel speed sensor ready; CSC and SMP DFU are advertising");
	err = run_sensor_stream();
	LOG_ERR("Sensor stream stopped: %d", err);

	reboot_unhealthy_image();
	return 0;
}
```

## src/wheel_csc.c
```c
/*
 * Copyright (c) 2026 Mateusz Zerebecki
 *
 * SPDX-License-Identifier: Apache-2.0
 */

#include "wheel_csc.h"

#include <errno.h>

#include <zephyr/bluetooth/bluetooth.h>
#include <zephyr/bluetooth/conn.h>
#include <zephyr/bluetooth/gatt.h>
#include <zephyr/bluetooth/hci.h>
#include <zephyr/bluetooth/services/bas.h>
#include <zephyr/bluetooth/uuid.h>
#include <zephyr/kernel.h>
#include <zephyr/logging/log.h>
#include <zephyr/mgmt/mcumgr/transport/smp_bt.h>
#include <zephyr/settings/settings.h>
#include <zephyr/sys/byteorder.h>

LOG_MODULE_REGISTER(wheel_csc, LOG_LEVEL_INF);

#define CSC_FEATURE_WHEEL_REVOLUTION BIT(0)
#define CSC_FLAG_WHEEL_REVOLUTION    BIT(0)
#define CSC_LOCATION_FRONT_HUB       0x09

static bool notifications_enabled;
static struct k_work advertise_work;

static void csc_ccc_changed(const struct bt_gatt_attr *attr, uint16_t value)
{
	ARG_UNUSED(attr);
	notifications_enabled = value == BT_GATT_CCC_NOTIFY;
}

static ssize_t read_csc_feature(struct bt_conn *conn, const struct bt_gatt_attr *attr, void *buf,
				uint16_t len, uint16_t offset)
{
	const uint16_t feature = sys_cpu_to_le16(CSC_FEATURE_WHEEL_REVOLUTION);

	return bt_gatt_attr_read(conn, attr, buf, len, offset, &feature, sizeof(feature));
}

static ssize_t read_sensor_location(struct bt_conn *conn, const struct bt_gatt_attr *attr,
				    void *buf, uint16_t len, uint16_t offset)
{
	const uint8_t location = CSC_LOCATION_FRONT_HUB;

	return bt_gatt_attr_read(conn, attr, buf, len, offset, &location, sizeof(location));
}

BT_GATT_SERVICE_DEFINE(wheel_csc_service, BT_GATT_PRIMARY_SERVICE(BT_UUID_CSC),
		       BT_GATT_CHARACTERISTIC(BT_UUID_CSC_MEASUREMENT, BT_GATT_CHRC_NOTIFY,
					      BT_GATT_PERM_NONE, NULL, NULL, NULL),
		       BT_GATT_CCC(csc_ccc_changed,
				   BT_GATT_PERM_READ_ENCRYPT | BT_GATT_PERM_WRITE_ENCRYPT),
		       BT_GATT_CHARACTERISTIC(BT_UUID_CSC_FEATURE, BT_GATT_CHRC_READ,
					      BT_GATT_PERM_READ, read_csc_feature, NULL, NULL),
		       BT_GATT_CHARACTERISTIC(BT_UUID_SENSOR_LOCATION, BT_GATT_CHRC_READ,
					      BT_GATT_PERM_READ, read_sensor_location, NULL, NULL));

struct csc_measurement {
	uint8_t flags;
	uint32_t cumulative_wheel_revolutions;
	uint16_t last_wheel_event_time;
} __packed;

void wheel_csc_publish(uint32_t cumulative_revolutions, uint16_t last_event_time_1024)
{
	struct csc_measurement measurement = {
		.flags = CSC_FLAG_WHEEL_REVOLUTION,
		.cumulative_wheel_revolutions = sys_cpu_to_le32(cumulative_revolutions),
		.last_wheel_event_time = sys_cpu_to_le16(last_event_time_1024),
	};
	int err;

	if (!notifications_enabled) {
		return;
	}

	err = bt_gatt_notify(NULL, &wheel_csc_service.attrs[2], &measurement, sizeof(measurement));
	if (err != 0 && err != -ENOTCONN) {
		LOG_WRN("CSC notification failed: %d", err);
	}
}

static const struct bt_data advertising_data[] = {
	BT_DATA_BYTES(BT_DATA_FLAGS, BT_LE_AD_GENERAL | BT_LE_AD_NO_BREDR),
	BT_DATA_BYTES(BT_DATA_UUID16_ALL, BT_UUID_16_ENCODE(BT_UUID_CSC_VAL),
		      BT_UUID_16_ENCODE(BT_UUID_BAS_VAL)),
	BT_DATA_BYTES(BT_DATA_UUID128_ALL, SMP_BT_SVC_UUID_VAL),
};

static const struct bt_data scan_response_data[] = {
	BT_DATA(BT_DATA_NAME_COMPLETE, CONFIG_BT_DEVICE_NAME, sizeof(CONFIG_BT_DEVICE_NAME) - 1),
};

static void advertise(struct k_work *work)
{
	int err;

	ARG_UNUSED(work);
	err = bt_le_adv_start(BT_LE_ADV_CONN_FAST_1, advertising_data, ARRAY_SIZE(advertising_data),
			      scan_response_data, ARRAY_SIZE(scan_response_data));
	if (err != 0 && err != -EALREADY) {
		LOG_ERR("Advertising failed: %d", err);
	}
}

static void connected(struct bt_conn *conn, uint8_t err)
{
	int rc;

	if (err != 0U) {
		LOG_WRN("Connection failed: 0x%02x %s", err, bt_hci_err_to_str(err));
		k_work_submit(&advertise_work);
		return;
	}

	LOG_INF("Connected");
	rc = bt_conn_set_security(conn, BT_SECURITY_L2);
	if (rc != 0 && rc != -EALREADY) {
		LOG_WRN("Could not request encrypted link: %d", rc);
	}
}

static void disconnected(struct bt_conn *conn, uint8_t reason)
{
	ARG_UNUSED(conn);
	LOG_INF("Disconnected: 0x%02x %s", reason, bt_hci_err_to_str(reason));
}

static void recycled(void)
{
	k_work_submit(&advertise_work);
}

static void security_changed(struct bt_conn *conn, bt_security_t level, enum bt_security_err err)
{
	ARG_UNUSED(conn);
	if (err == BT_SECURITY_ERR_SUCCESS) {
		LOG_INF("Link security level %u", level);
	} else {
		LOG_WRN("Security failed: %s", bt_security_err_to_str(err));
	}
}

BT_CONN_CB_DEFINE(wheel_conn_callbacks) = {
	.connected = connected,
	.disconnected = disconnected,
	.recycled = recycled,
	.security_changed = security_changed,
};

int wheel_csc_start(void)
{
	int err;

	k_work_init(&advertise_work, advertise);
	err = bt_enable(NULL);
	if (err != 0) {
		return err;
	}

	if (IS_ENABLED(CONFIG_SETTINGS)) {
		err = settings_load();
		if (err != 0) {
			return err;
		}
	}

	/* Replace this placeholder after the battery measurement circuit is known. */
	bt_bas_set_battery_level(100U);
	k_work_submit(&advertise_work);
	return 0;
}
```

## src/wheel_csc.h
```c
/*
 * Copyright (c) 2026 Mateusz Zerebecki
 *
 * SPDX-License-Identifier: Apache-2.0
 */

#ifndef WHEEL_CSC_H_
#define WHEEL_CSC_H_

#include <stdint.h>

int wheel_csc_start(void);
void wheel_csc_publish(uint32_t cumulative_revolutions, uint16_t last_event_time_1024);

#endif /* WHEEL_CSC_H_ */
```

## src/wheel_detector.c
```c
/*
 * Copyright (c) 2026 Mateusz Zerebecki
 *
 * SPDX-License-Identifier: Apache-2.0
 */

#include "wheel_detector.h"

#include <math.h>
#include <string.h>

#define PI_F                         3.14159265358979323846f
#define FULL_ROTATION_RAD            (2.0f * PI_F)
#define NANOSECONDS_PER_SECOND       1000000000ULL
#define CENTER_FILTER_ALPHA          0.005f
#define MIN_ROTATING_VECTOR_MS2      2.0f
#define MAX_PHASE_STEP_RAD           1.6f
#define MIN_REVOLUTION_TIME_NS       70000000ULL
#define MAX_REVOLUTION_TIME_NS       5000000000ULL
#define DETECTOR_WARMUP_SAMPLE_COUNT 100U

void wheel_detector_init(struct wheel_detector *detector)
{
	memset(detector, 0, sizeof(*detector));
}

static float unwrap_phase_step(float step)
{
	if (step > PI_F) {
		step -= FULL_ROTATION_RAD;
	} else if (step < -PI_F) {
		step += FULL_ROTATION_RAD;
	}

	return step;
}

bool wheel_detector_process(struct wheel_detector *detector, float x_ms2, float y_ms2,
			    uint64_t timestamp_ns, struct wheel_revolution_event *event)
{
	float phase;
	float phase_step;
	float rotating_x;
	float rotating_y;
	float radius_squared;
	uint64_t revolution_time_ns;

	if (detector->warmup_samples == 0U) {
		detector->center_x = x_ms2;
		detector->center_y = y_ms2;
	}

	detector->center_x += CENTER_FILTER_ALPHA * (x_ms2 - detector->center_x);
	detector->center_y += CENTER_FILTER_ALPHA * (y_ms2 - detector->center_y);
	detector->warmup_samples++;

	rotating_x = x_ms2 - detector->center_x;
	rotating_y = y_ms2 - detector->center_y;
	radius_squared = rotating_x * rotating_x + rotating_y * rotating_y;

	if (detector->warmup_samples < DETECTOR_WARMUP_SAMPLE_COUNT ||
	    radius_squared < MIN_ROTATING_VECTOR_MS2 * MIN_ROTATING_VECTOR_MS2) {
		detector->phase_valid = false;
		detector->accumulated_phase = 0.0f;
		return false;
	}

	phase = atan2f(rotating_y, rotating_x);
	if (!detector->phase_valid) {
		detector->previous_phase = phase;
		detector->previous_timestamp_ns = timestamp_ns;
		detector->phase_valid = true;
		return false;
	}

	phase_step = unwrap_phase_step(phase - detector->previous_phase);
	detector->previous_phase = phase;
	detector->previous_timestamp_ns = timestamp_ns;

	/* A single large jump is an impact, not plausible wheel rotation. */
	if (fabsf(phase_step) > MAX_PHASE_STEP_RAD) {
		detector->phase_valid = false;
		detector->accumulated_phase = 0.0f;
		return false;
	}

	/* Do not let vibration in the opposite direction erase a nearly complete turn. */
	if (detector->accumulated_phase != 0.0f &&
	    ((detector->accumulated_phase > 0.0f) != (phase_step > 0.0f)) &&
	    fabsf(phase_step) > 0.35f) {
		detector->accumulated_phase = 0.0f;
	}
	detector->accumulated_phase += phase_step;

	if (fabsf(detector->accumulated_phase) < FULL_ROTATION_RAD) {
		return false;
	}

	revolution_time_ns = detector->last_revolution_ns == 0U
				     ? 0U
				     : timestamp_ns - detector->last_revolution_ns;
	detector->accumulated_phase = fmodf(detector->accumulated_phase, FULL_ROTATION_RAD);

	if (detector->last_revolution_ns != 0U && (revolution_time_ns < MIN_REVOLUTION_TIME_NS ||
						   revolution_time_ns > MAX_REVOLUTION_TIME_NS)) {
		detector->last_revolution_ns = timestamp_ns;
		return false;
	}

	detector->last_revolution_ns = timestamp_ns;
	detector->cumulative_revolutions++;
	event->cumulative_revolutions = detector->cumulative_revolutions;
	event->timestamp_ns = timestamp_ns;
	event->last_event_time_1024 =
		(uint16_t)((timestamp_ns / NANOSECONDS_PER_SECOND % 64U) * 1024U +
			   (timestamp_ns % NANOSECONDS_PER_SECOND) * 1024U /
				   NANOSECONDS_PER_SECOND);

	return true;
}
```

## src/wheel_detector.h
```c
/*
 * Copyright (c) 2026 Mateusz Zerebecki
 *
 * SPDX-License-Identifier: Apache-2.0
 */

#ifndef WHEEL_DETECTOR_H_
#define WHEEL_DETECTOR_H_

#include <stdbool.h>
#include <stdint.h>

struct wheel_revolution_event {
	uint32_t cumulative_revolutions;
	uint64_t timestamp_ns;
	uint16_t last_event_time_1024;
};

struct wheel_detector {
	float center_x;
	float center_y;
	float previous_phase;
	float accumulated_phase;
	uint64_t previous_timestamp_ns;
	uint64_t last_revolution_ns;
	uint32_t cumulative_revolutions;
	uint32_t warmup_samples;
	bool phase_valid;
};

void wheel_detector_init(struct wheel_detector *detector);
bool wheel_detector_process(struct wheel_detector *detector, float x_ms2, float y_ms2,
			    uint64_t timestamp_ns, struct wheel_revolution_event *event);

#endif /* WHEEL_DETECTOR_H_ */
```
